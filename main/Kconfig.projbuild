## main/Kconfig.projbuild
```kconfig
# ============================================================
#  Acoustic Guitar FX + Tuner — ESP32-S3 N16R8 (Phase 1)
#  Pin map follows ARCHITECTURE.md / pinout table:
#   I2S0 RX : PCM1808   BCLK=4  LRCK=5  DATA=6   (ESP32 is I2S master, no MCLK wire)
#   I2S1 TX : MAX98357A BCLK=15 LRCK=16 DATA=17  (internal PLL, no MCLK wire)
#   I2C     : OLED      SDA=8   SCL=9
#   Control : Encoder   A=10    B=11    SW=12 ; BTN1=13 ; BTN2=14
#   Analog  : Battery   GPIO2   (ADC1_CH1, via divider)
# ============================================================

config SAMPLE_RATE
    int "Audio sample rate (Hz)"
    default 48000

config AUDIO_FRAME_SAMPLES
    int "Samples per processing block (per channel)"
    default 128
    help Ring-block size. 128 @ 48 kHz = ~2.66 ms granularity.

config TUNER_ENABLED
    bool "Enable chromatic tuner"
    default y

# ---------------- Anti-feedback chain ----------------
config HPF_CUTOFF_HZ
    int "High-pass cutoff (Hz), suppresses body/soundhole feedback"
    default 80
    help Stored in settings as kHz*10 (uint8 field): 80 -> 800. Valid UI
         choices are OFF/80/90/100 Hz; any other value is clamped by the DSP.

config LIMITER_THRESHOLD
    hex "Soft-clip threshold (Q15). 0x7fff = full scale"
    default 0x5cc0
    help Transients above ~0.36 FS are softly compressed (anti-larsen).

config OUTPUT_GAIN_PCT
    int "Master output gain in percent (conservative vs. feedback)"
    range 0 100
    default 70

# ---------------- Effect defaults (presets stored in NVS override) ----------------
config DELAY_TIME_MS_DFLT
    int "Default slap-back delay time (ms)"
    default 90

config DELAY_FEEDBACK_PCT_DFLT
    int "Default delay feedback (%)"
    default 30

config DELAY_MIX_PCT_DFLT
    int "Default delay wet mix (%)"
    default 25

config CHORUS_RATE_MHZ
    int "Default chorus LFO rate (mHz)"
    default 550

config CHORUS_DEPTH_US
    int "Default chorus depth (microseconds of delay modulation)"
    default 600

config CHORUS_MIX_PCT_DFLT
    int "Default chorus wet mix (%)"
    default 30

config REVERB_MIX_PCT_DFLT
    int "Default reverb wet mix (%)"
    default 35

# ---------------- UI timing ----------------
config UI_PERIOD_MS
    int "UI / tuner refresh period (ms)"
    default 20

# ---------------- Battery monitor ----------------
menu "Battery ADC (GPIO2 = ADC1_CH1, via resistor divider)"
    config BAT_DIVIDER_X100
        int "Divider ratio x100 (Vbat/Vadc), e.g. 300 for Rtop=2M Rbot=1M"
        default 300
    config BAT_FULL_MV
        int "Battery mV that maps to 100% charge"
        default 4200
    config BAT_EMPTY_MV
        int "Battery mV that maps to 0% charge (LDO headroom limit)"
        default 3200
endmenu

# ---------------- Pin assignments (ESP32-S3-WROOM-1, per ARCHITECTURE.md) ----------------
menu "I2S pin assignments"
    config I2S_IN_BCK_PIN
        int "PCM1808 BCLK GPIO (ESP32 is I2S master)"
        default 4
    config I2S_IN_WS_PIN
        int "PCM1808 LRCK / WS GPIO"
        default 5
    config I2S_IN_DIN_PIN
        int "PCM1808 DOUT -> ESP32 SD input GPIO"
        default 6
    config I2S_IN_MCLK_PIN
        int "PCM1808 MCLK GPIO (-1 = not wired; PCM1808 accepts BCLK-only clocking)"
        default -1

    config I2S_OUT_BCK_PIN
        int "MAX98357A BCLK GPIO"
        default 15
    config I2S_OUT_WS_PIN
        int "MAX98357A L/RCLK GPIO"
        default 16
    config I2S_OUT_DOUT_PIN
        int "MAX98357A DIN GPIO"
        default 17
    config I2S_OUT_MCLK_PIN
        int "MAX98357A MCLK GPIO (-1 = not connected, internal PLL)"
        default -1
endmenu

menu "OLED (I2C) pins"
    config OLED_I2C_PORT
        int "I2C port for the OLED (0 or 1)"
        default 0

    config OLED_SDA_PIN
        int "OLED SDA GPIO"
        default 8
    config OLED_SCL_PIN
        int "OLED SCL GPIO"
        default 9
    config OLED_ADDR
        hex "SSD1306 I2C address (0x3c or 0x3d)"
        default 0x3c
endmenu

menu "Encoder & buttons"
    config ENC_A_PIN
        int "Rotary encoder CLK (A) GPIO"
        default 10
    config ENC_B_PIN
        int "Rotary encoder DT (B) GPIO"
        default 11
    config BTN_ENC_PIN
        int "Rotary encoder push-switch GPIO (UI select / parameter edit)"
        default 12
    config BTN_ACT_PIN
        int "Push button 1 GPIO (short: bypass, long: tuner toggle)"
        default 13
    config BTN_PRESET_PIN
        int "Push button 2 GPIO (preset cycle)"
        default 14
endmenu
```
